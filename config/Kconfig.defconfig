## config/Kconfig.defconfig
```kconfig
# Copyright (c) 2023 You
# SPDX-License-Identifier: MIT

if SHIELD_ORTHODOX_LEFT

config ZMK_KEYBOARD_NAME
  default "Orthodox Left"

config ZMK_SPLIT_ROLE_CENTRAL
  default y

endif

if SHIELD_ORTHODOX_LEFT || SHIELD_ORTHODOX_RIGHT

config ZMK_SPLIT
  default y

endif
```

## config/boards/shields/orthodox/Kconfig.shield
```kconfig
# Copyright (c) 2023 You
# SPDX-License-Identifier: MIT

config SHIELD_ORTHODOX_LEFT
  def_bool $(shields_list_contains,orthodox_left)

config SHIELD_ORTHODOX_RIGHT
  def_bool $(shields_list_contains,orthodox_right)
```
